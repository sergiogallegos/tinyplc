/* Handwritten adversarial images, never generated by the ST frontend.
 * First three scans commit LED=1 and N=1..3; fourth scan dirties working N,
 * then attempts the selected violation. No runtime imports. */
.syntax unified
.cpu cortex-m4
.fpu fpv4-sp-d16
.thumb
.section .text,"ax",%progbits
.global tinyplc_scan
.type tinyplc_scan,%function
.thumb_func
tinyplc_scan:
    ldr r2, [r1, #8]
    cmp r2, #3
    bhs attack
    adds r2, #1
    str r2, [r1, #8]
    movs r2, #1
    str r2, [r1, #4]
    movs r0, #0
    bx lr
attack:
    movw r2, #999
    str r2, [r1, #8]
#if PROBE == 1
    ldr r0, =0x20000000 /* privileged RAM write */
    str r2, [r0]
#elif PROBE == 2
    str r2, [r0] /* frozen input write */
#elif PROBE == 3
    ldr r0, =tinyplc_scan
    bic r0, r0, #1
    str r2, [r0] /* code write */
#elif PROBE == 4
    ldr r0, =0x40020018
    str r2, [r0] /* physical GPIO bypass */
#elif PROBE == 5
    ldr r0, =0x20000000
    ldr r2, [r0] /* privileged RAM read */
#elif PROBE == 6
    movw r2, #0x4770
    str r2, [r1, #16]
    adds r0, r1, #17
    blx r0 /* execute working data */
#elif PROBE == 7
    svc #102 /* attempt FreeRTOS raise-privilege service directly */
#elif PROBE == 8
1:  b 1b /* infinite native execution */
#elif PROBE == 9
    ldr r0, =0x20018000
    mov sp, r0
    svc #200 /* invalid PSP detected by gateway: reset fallback */
#elif PROBE == 10
    cpsid i /* unprivileged code must not be able to mask the deadline IRQ */
1:  b 1b
#elif PROBE == 11
    vadd.f32 s0, s0, s0 /* FP is not in ABI 2; NOCP usage fault */
#elif PROBE == 12
    svc #200 /* correct service number, wrong call site */
#elif PROBE == 13
    ldr r0, =0x200187fc
    str r2, [r0] /* stack guard below mapped stack */
#elif PROBE == 14
    ldr r0, =0x08000001
    blx r0 /* execute supervisor flash */
#elif PROBE == 15
    svc #100 /* attempt scheduler-start service directly */
#elif PROBE == 16
    ldr r0, =0x20030000 /* outside permitted worker stack: gateway rejection */
    mov sp, r0
    svc #200
#elif PROBE == 17
    ldr r0, =0x20010100 /* stack into read-only code: hardware stacking fault */
    mov sp, r0
    svc #200
#elif PROBE == 18
    mov r0, lr
    bic r0, r0, #3
    str r2, [r0] /* attempted write to firmware return gateway */
#elif PROBE == 19
    ldr r0, =tinyplc_scan
    eor r0, r0, #0x4000 /* same offset in inactive slot */
    bic r0, r0, #3
    str r2, [r0]
#elif PROBE == 20
    ldr r0, =0x20018100 /* supervisor-owned dispatch descriptor */
    str r2, [r0]
#endif
    movs r0, #0
    bx lr
.ltorg
.section .rodata,"a",%progbits
.balign 4
.global tinyplc_abi_version, tinyplc_tag_count, tinyplc_tag_types, tinyplc_tag_classes
tinyplc_abi_version: .word 2
tinyplc_tag_count: .word 3
tinyplc_tag_types: .byte 1, 1, 2
tinyplc_tag_classes: .byte 1, 2, 3
.section .note.GNU-stack,"",%progbits
